#include <dt-bindings/zmk/mouse.h>

&mmv {
  acceleration-exponent = <1>;      // 1
  time-to-max-speed-ms = <1500>;    // 40
  delay-ms = <0>;                   // 0
};

&msc {
  acceleration-exponent = <1>;      // 0
  time-to-max-speed-ms = <5000>;    // 40
  delay-ms = <0>;                   // 10
};

#define U_MOUSE_MOVE_MAX 1250       // 600
#define U_MOUSE_SCROLL_MAX 100      // 10

#define U_BTN1 &mkp MB1
#define U_BTN2 &mkp MB2
#define U_BTN3 &mkp MB3
#define U_MS_U &mmv MOVE_UP(-U_MOUSE_MOVE_MAX)
#define U_MS_D &mmv MOVE_DOWN(U_MOUSE_MOVE_MAX)
#define U_MS_L &mmv MOVE_LEFT(-U_MOUSE_MOVE_MAX)
#define U_MS_R &mmv MOVE_RIGHT(U_MOUSE_MOVE_MAX)
#define U_WH_U &msc SCROLL_UP(U_MOUSE_SCROLL_MAX)
#define U_WH_D &msc SCROLL_DOWN(-U_MOUSE_SCROLL_MAX)
#define U_WH_L &msc SCROLL_LEFT(-U_MOUSE_SCROLL_MAX)
#define U_WH_R &msc SCROLL_RIGHT(U_MOUSE_SCROLL_MAX)
